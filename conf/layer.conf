## conf/layer.conf
```bitbake
# We have a conf and classes directory, add to BBPATH
BBPATH .= ":${LAYERDIR}"

# We have recipes-* directories, add to BBFILES
BBFILES += "${LAYERDIR}/recipes-*/*/*.bb \
            ${LAYERDIR}/recipes-*/*/*.bbappend"

BBFILE_COLLECTIONS += "meta-wpi-desktop"
BBFILE_PATTERN_meta-wpi-desktop = "^${LAYERDIR}/"
BBFILE_PRIORITY_meta-wpi-desktop = "6"

LAYERDEPENDS_meta-wpi-desktop = "core"
LAYERSERIES_COMPAT_meta-wpi-desktop = "kirkstone"
```
